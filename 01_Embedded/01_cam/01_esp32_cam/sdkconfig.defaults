## 01_Embedded/01_cam/01_esp32_cam/sdkconfig.defaults
```kconfig
CONFIG_FATFS_VFS_FSTAT_BLKSIZE=4096

CONFIG_EXAMPLE_WIFI_SSID="aaaa"
CONFIG_EXAMPLE_WIFI_PASSWORD="00000000"
```

## 01_Embedded/02_csi/02_esp32_s3_rx/sdkconfig.defaults
```kconfig
CONFIG_SOC_WIFI_CSI_SUPPORT=y
CONFIG_ESP_WIFI_CSI_ENABLED=y
CONFIG_ESP32_WIFI_CSI_ENABLED=y
```
